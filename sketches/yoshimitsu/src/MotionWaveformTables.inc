// Generated by scripts/gen_wave_lut.py — do not edit by hand.
// Wave-shape lookup tables for FlappingOscillator::shapeWave().
// PROGMEM (flash .irom.text) — zero DRAM cost; read via memory-mapped
// flash cache (no pgm_read needed). N=256 intervals, ROWS=16.

#include "MotionWaveform.h"

// cos(pi*u), u in [0,1] -> [1,-1].
const float kWaveCosHalf[257] PROGMEM = {
    1.0f, 0.999924702f, 0.999698819f, 0.999322385f, 0.998795456f, 0.998118113f, 0.997290457f, 0.996312612f,
    0.995184727f, 0.99390697f, 0.992479535f, 0.990902635f, 0.98917651f, 0.987301418f, 0.985277642f, 0.983105487f,
    0.98078528f, 0.978317371f, 0.97570213f, 0.972939952f, 0.970031253f, 0.966976471f, 0.963776066f, 0.960430519f,
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    -1.0f,
};

// asin(pointK*cos(pi*u)) / asin(pointK); rows span pointK in [~0, 0.98].
// Row 0 is the pointK->0 limit (= cos(pi*u), i.e. half-cosine).
const float kWavePointed[16][257] PROGMEM = {
    {
        1.0f, 0.999924702f, 0.999698819f, 0.999322385f, 0.998795456f, 0.998118113f, 0.997290457f, 0.996312612f,
        0.995184727f, 0.99390697f, 0.992479535f, 0.990902635f, 0.98917651f, 0.987301418f, 0.985277642f, 0.983105487f,
        0.98078528f, 0.978317371f, 0.97570213f, 0.972939952f, 0.970031253f, 0.966976471f, 0.963776066f, 0.960430519f,
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        -1.0f,
    },
    {
        1.0f, 0.999924594f, 0.999698389f, 0.999321418f, 0.99879374f, 0.998115435f, 0.997286605f, 0.996307378f,
        0.995177904f, 0.993898353f, 0.992468922f, 0.990889828f, 0.989161312f, 0.987283638f, 0.985257092f, 0.983081983f,
        0.980758643f, 0.978287425f, 0.975668707f, 0.972902887f, 0.969990388f, 0.966931652f, 0.963727146f, 0.960377358f,
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        -1.0f,
    },
    {
        1.0f, 0.999924268f, 0.999697084f, 0.999318483f, 0.998788526f, 0.998107297f, 0.997274904f, 0.996291478f,
        0.995157176f, 0.993872176f, 0.992436683f, 0.990850923f, 0.989115148f, 0.987229632f, 0.985194673f, 0.983010594f,
        0.980677739f, 0.978196478f, 0.975567202f, 0.972790326f, 0.96986629f, 0.966795555f, 0.963578604f, 0.960215947f,
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        -1.0f,
    },
    {
        1.0f, 0.99992371f, 0.999694852f, 0.999313464f, 0.998779612f, 0.998093385f, 0.997254899f, 0.996264295f,
        0.99512174f, 0.993827426f, 0.992381572f, 0.99078442f, 0.98903624f, 0.987137325f, 0.985087995f, 0.982888593f,
        0.980539489f, 0.978041076f, 0.975393775f, 0.972598027f, 0.969654301f, 0.966563089f, 0.963324908f, 0.959940297f,
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        -1.0f,
    },
    {
        1.0f, 0.999922897f, 0.999691602f, 0.999306157f, 0.998766633f, 0.99807313f, 0.997225774f, 0.996224722f,
        0.995070155f, 0.993762288f, 0.992301358f, 0.990687633f, 0.988921409f, 0.987003007f, 0.98493278f, 0.982711103f,
        0.980338382f, 0.977815048f, 0.97514156f, 0.972318404f, 0.96934609f, 0.966225157f, 0.962956169f, 0.959539716f,
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        -1.0f,
    },
    {
        1.0f, 0.999921794f, 0.999687191f, 0.99929624f, 0.998749021f, 0.998045645f, 0.997186256f, 0.99617103f,
        0.995000173f, 0.993673925f, 0.992192555f, 0.990556365f, 0.988765687f, 0.986820884f, 0.984722351f, 0.982470512f,
        0.980065822f, 0.977508764f, 0.974799855f, 0.971939636f, 0.968928682f, 0.965767594f, 0.962457003f, 0.958997565f,
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        -1.0f,
    },
    {
        1.0f, 0.999920347f, 0.999681407f, 0.999283235f, 0.998725924f, 0.998009603f, 0.997134439f, 0.996100635f,
        0.994908429f, 0.993558099f, 0.992049956f, 0.990384349f, 0.98856166f, 0.986582309f, 0.984446749f, 0.982155471f,
        0.979708996f, 0.977107881f, 0.974352718f, 0.97144413f, 0.968382773f, 0.965169336f, 0.96180454f, 0.958289135f,
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        -1.0f,
    },
    {
        1.0f, 0.999918477f, 0.999673931f, 0.999266428f, 0.998696077f, 0.997963033f, 0.997067492f, 0.996009696f,
        0.99478993f, 0.993408519f, 0.991865834f, 0.990162287f, 0.988298332f, 0.986274463f, 0.984091218f, 0.981749172f,
        0.979248942f, 0.976591184f, 0.973776591f, 0.970805897f, 0.96767987f, 0.964399316f, 0.960965079f, 0.957378034f,
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        -1.0f,
    },
    {
        1.0f, 0.999916064f, 0.999664285f, 0.999244741f, 0.998657568f, 0.997902954f, 0.996981139f, 0.995892416f,
        0.994637134f, 0.993215689f, 0.991628532f, 0.989876164f, 0.987959136f, 0.985878049f, 0.983633552f, 0.981226344f,
        0.978657169f, 0.975926819f, 0.973036131f, 0.969985984f, 0.966777304f, 0.963411056f, 0.959888249f, 0.956209929f,
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        -1.0f,
    },
    {
        1.0f, 0.999912921f, 0.999651716f, 0.999216488f, 0.998607406f, 0.997824706f, 0.996868691f, 0.995739732f,
        0.994438263f, 0.992964785f, 0.991319863f, 0.989504124f, 0.987518259f, 0.985363017f, 0.983039211f, 0.98054771f,
        0.97788944f, 0.975065383f, 0.972076575f, 0.968924107f, 0.965609117f, 0.962132795f, 0.958496378f, 0.954701147f,
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        -1.0f,
    },
    {
        1.0f, 0.999908735f, 0.999634985f, 0.999178883f, 0.99854065f, 0.997720597f, 0.99671912f, 0.995536703f,
        0.994173914f, 0.992631406f, 0.990909914f, 0.989010256f, 0.986933326f, 0.984680098f, 0.982251621f, 0.979649017f,
        0.976873478f, 0.973926265f, 0.970808706f, 0.967522192f, 0.964068173f, 0.96044816f, 0.956663717f, 0.952716462f,
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        -1.0f,
    },
    {
        1.0f, 0.999902954f, 0.999611878f, 0.999126956f, 0.998448493f, 0.997576918f, 0.996512778f, 0.995256737f,
        0.993809579f, 0.992172198f, 0.990345602f, 0.988330908f, 0.986129335f, 0.983742207f, 0.981170946f, 0.978417067f,
        0.975482176f, 0.972367965f, 0.96907621f, 0.965608761f, 0.961967543f, 0.958154548f, 0.954171835f, 0.950021517f,
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        -1.0f,
    },
    {
        1.0f, 0.999894468f, 0.999577963f, 0.999050761f, 0.998313319f, 0.997366276f, 0.996210445f, 0.994846818f,
        0.993276554f, 0.991500977f, 0.989521573f, 0.987339982f, 0.98495799f, 0.982377526f, 0.979600652f, 0.976629556f,
        0.973466544f, 0.970114033f, 0.966574542f, 0.962850685f, 0.958945161f, 0.954860745f, 0.950600283f, 0.946166682f,
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        -1.0f,
    },
    {
        1.0f, 0.999880613f, 0.999522609f, 0.99892646f, 0.998092948f, 0.997023161f, 0.995718485f, 0.994180598f,
        0.992411457f, 0.990413285f, 0.98818856f, 0.985740002f, 0.983070551f, 0.980183359f, 0.977081766f, 0.973769286f,
        0.970249591f, 0.966526488f, 0.962603908f, 0.958485884f, 0.954176536f, 0.949680055f, 0.945000686f, 0.940142715f,
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        -1.0f,
    },
    {
        1.0f, 0.999852465f, 0.999410223f, 0.998674358f, 0.997646662f, 0.996329615f, 0.994726351f, 0.992840629f,
        0.990676784f, 0.988239682f, 0.985534671f, 0.982567525f, 0.979344389f, 0.975871723f, 0.972156247f, 0.96820489f,
        0.964024735f, 0.959622971f, 0.955006849f, 0.950183638f, 0.94516059f, 0.939944904f, 0.934543695f, 0.928963971f,
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        -1.0f,
    },
    {
        1.0f, 0.999729666f, 0.998921644f, 0.997584704f, 0.99573295f, 0.9933851f, 0.990563611f, 0.987293718f,
        0.98360248f, 0.979517895f, 0.975068136f, 0.970280923f, 0.965183035f, 0.959799973f, 0.954155726f, 0.948272649f,
        0.94217141f, 0.935871007f, 0.929388813f, 0.922740659f, 0.915940931f, 0.909002678f, 0.901937713f, 0.894756732f,
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        -1.0f,
    },
};
